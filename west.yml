## west.yml
```yaml
# Copyright (c) 2021 Nordic Semiconductor ASA
# SPDX-License-Identifier: Apache-2.0

manifest:
  self:
    west-commands: scripts/west-commands.yml

  remotes:
    - name: zephyrproject-rtos
      url-base: https://github.com/zephyrproject-rtos
    - name: esp
      url-base: https://github.com/sylvioalves/

  projects:
    - name: zephyr
      remote: zephyrproject-rtos
      revision: main
      import:
        # By using name-allowlist we can clone only the modules that are
        # strictly needed by the application.
        name-allowlist:
          - cmsis      # required by the ARM port
          - hal_espressif
          - tinycrypt
          - mcuboot
          - mbedtls
    # - name: hal_espressif
    #   remote: esp
    #   revision: esp32c6_bt
    #   path: modules/hal/espressif
```
